## subsys/nsb/Kconfig
```kconfig
#
# Copyright (c) 2018 Nordic Semiconductor ASA
#
# SPDX-License-Identifier: LicenseRef-BSD-5-Clause-Nordic
#

config MCUBOOT_BUILD_S1_VARIANT
	# This can not depend on BOOTLOADER_MCUBOOT, or NSB_BOOTLOADER as this
	# option has to be set when building MCUBoot itself. Instead an error
	# is raised by CMake if an incorrect configuration is found.
	bool "Build S1 variant of MCUBoot"
	help
	  Build upgrade candidate of MCUBoot for alternative slot S1.

config NSB_CRYPTO_CLIENT
	bool "Include Secure Bootloader crypto client API"
	help
	  Set this option to enable the crypto client API
	  which gives access to the cryptographic functions
	  from the secure bootloader. This will only work
	  when the secure bootloader is enabled.

config NSB_BOOTLOADER
	bool "Include Nordic Secure Boot bootloader"
	depends on !IS_NSB_BOOTLOADERLOADER
	select FW_METADATA
	select NSB_CRYPTO
	help
	  Set this option to enable the first stage bootloader which
	  verifies the signature of the app. This fulfills the role of B0.

if NSB_BOOTLOADER

module=B0
source "${ZEPHYR_BASE}/../nrf/subsys/partition_manager/Kconfig.template.build_strategy"

config NSB_PRIVATE_KEY_PROVIDED
	bool
	help
	  Hidden config specifying whether the build system has access to the
	  private key used for signing, and will use it to perform signing and
	  create the public key for the provision page.


choice NSB_SIGNING
	prompt "Firmware signing method"
	default NSB_SIGNING_PYTHON
	config NSB_SIGNING_PYTHON
		bool "Sign with Python ecdsa library."
		select NSB_PRIVATE_KEY_PROVIDED

	config NSB_SIGNING_OPENSSL
		bool "Sign with openssl command line tool."
		select NSB_PRIVATE_KEY_PROVIDED

	config NSB_SIGNING_CUSTOM
		bool "Sign with custom command."
endchoice

config NSB_SIGNING_KEY_FILE
	string
	prompt "Private key PEM file" if NSB_PRIVATE_KEY_PROVIDED
	default ""
	help
	  Absolute path to the private key PEM file.
	  Specifies the private key used for signing the firmware image.
	  The hash of the corresponding public key is stored as the first
	  entry in the list of public key hashes in the provision hex file.
	  This value can also be set by exporting an environment variable
	  named 'SB_SIGNING_KEY_FILE' or passing
	  '-DSB_SIGNING_KEY_FILE=/path/to/my/pem' when running cmake.
	  See also NSB_PUBLIC_KEY_FILES.

config NSB_SIGNING_COMMAND
	string
	prompt "Custom signing command" if !SB_PRIVATE_KEY_PROVIDED
	default ""
	help
	  This command will be called to produce a signature of the firmware.
	  It will be called as "${CONFIG_NSB_SIGNING_COMMAND} <file>"
	  The command must take calculate the signature over the the contents
	  of the <file> and write the signature to stdout.
	  The signature must be on DER format.

config NSB_SIGNING_PUBLIC_KEY
	string
	prompt "Public key PEM file" if !SB_PRIVATE_KEY_PROVIDED
	default ""
	help
	  Path to a PEM file.
	  When using a custom signing command, specify the corresponding public
	  key here. This public key is checked during building, and added to
	  the provision page as the first entry. See NSB_PUBLIC_KEY_FILES.

config NSB_PUBLIC_KEY_FILES
	string "Public Key PEM files"
	default ""
	help
	  Comma-separated list of absolute paths to public key pem files.
	  The provision hex file will contain a list of hashes of public keys.
	  The first public key hash is the one corresponding to the private
	  signing key used to sign the image. See NSB_SIGNING_KEY_FILE.
	  The hashes of the public keys specified in this configuration will be
	  placed after the aforementioned public key hash, in the order
	  they appear in this config.
	  If config is an empty string, 2 generated debug files
	  will be used.
	  Example value: ~/keys/pk1.pem,~/keys/pk2.pem,~/keys/pk3.pem


endif # NSB_BOOTLOADER

menuconfig IS_NSB_BOOTLOADERLOADER
	bool "Current app is bootloader"
	select NSB_CRYPTO
	select SW_VECTOR_RELAY if SOC_SERIES_NRF51X
	select FW_METADATA
	help
	  This option is set by the first stage bootloader app to include all
	  files and set all the options required.

if IS_NSB_BOOTLOADERLOADER

partition=B0
partition-size=0x8000
source "${ZEPHYR_BASE}/../nrf/subsys/partition_manager/Kconfig.template.partition_size"

menuconfig NSB_DEBUG
	bool "Printing"
	select BOOT_BANNER
	select PRINTK
	select CONSOLE
	select SERIAL

if NSB_DEBUG
choice NSB_DEBUG_BACKEND
	prompt "Where to print to"
	default NSB_DEBUG_UART

config NSB_DEBUG_UART
	bool "Print to UART."
	select UART_NRFX
	select UART_CONSOLE

config NSB_DEBUG_RTT
	bool "Print to RTT"
	select RTT_CONSOLE
	select USE_SEGGER_RTT
endchoice

config NSB_BPROT_IN_DEBUG
	bool "Enable block protect in debug"
	default y
	depends on (HAS_HW_NRF_BPROT || HAS_HW_NRF_MPU)

endif # NSB_DEBUG
endif # IS_NSB_BOOTLOADERLOADER

if IS_NSB_BOOTLOADERLOADER || NSB_BOOTLOADER
config NSB_FIRMWARE_INFO_OFFSET
	hex
	default FW_FIRMWARE_INFO_OFFSET

rsource "nsb_crypto/Kconfig"
endif # IS_NSB_BOOTLOADERLOADER || NSB_BOOTLOADER
```

## subsys/nsb/nsb_crypto/Kconfig
```kconfig
#
# Copyright (c) 2018 Nordic Semiconductor ASA
#
# SPDX-License-Identifier: LicenseRef-BSD-5-Clause-Nordic
#

menuconfig NSB_CRYPTO
	bool
	prompt "Secure Boot Crypto"

if (NSB_CRYPTO)
config NSB_ECDSA_SECP256R1
	bool
	select FW_ECDSA_SECP256R1
config NSB_RSA_PSS2048
	bool
	select FW_RSA_PSS2048
config NSB_SHA256
	bool
	select FW_SHA256

config NSB_SIGNATURE_LEN
	int
	default 64 if NSB_ECDSA_SECP256R1
	default 256 if NSB_RSA_PSS2048

config NSB_PUBLIC_KEY_LEN
	int
	default 64 if NSB_ECDSA_SECP256R1
	default 256 if NSB_RSA_PSS2048

config NSB_HASH_LEN
	def_int 32

choice NSB_CRYPTO_SIG
	prompt "Firmware verification Algorithm"
	default NSB_CRYPTO_CC310_ECDSA_SECP256R1 if HAS_HW_NRF_CC310
	default NSB_CRYPTO_OBERON_ECDSA_SECP256R1
	help
	  Crypto implementation to use for signature verification of firmware in Bootloader.

	config NSB_CRYPTO_OBERON_ECDSA_SECP256R1
		bool "Software ECDSA secp256r1"
		select NRF_OBERON
		select NSB_ECDSA_SECP256R1
		help
		  Software implementation of ECDSA with NIST curve secp256r1.

	config NSB_CRYPTO_CC310_ECDSA_SECP256R1
		bool "Hardware ECDSA secp256r1" if HAS_HW_NRF_CC310
		select NRF_CC310_BL
		select NSB_ECDSA_SECP256R1
		help
		  Hardware implementation of ECDSA with NIST curve secp256r1.

	#config NSB_CRYPTO_OBERON_RSA_2048
	#	bool #"Software RSA-PSS 2048-bits"
	#	select NRF_OBERON
	#	select NSB_RSA_PSS2048
	#	help
	#	  Software implementation of RSASSA-PSS, 2048-bits.
	#	  Not available yet.

	#config NSB_CRYPTO_CC310_RSA_2048
	#	bool #"Hardware RSA-PSS 2048-bits" if HAS_HW_NRF_CC310
	#	select NRF_CC310_BL
	#	select NSB_RSA_PSS2048
	#	help
	#	  Hardware implementation of RSASSA-PSS, 2048-bits.
	#	  Not available yet.

endchoice

choice NSB_CRYPTO_HASH
	prompt "Hashing Implementation"
	default NSB_CRYPTO_CC310_SHA256 if HAS_HW_NRF_CC310
	default NSB_CRYPTO_OBERON_SHA256
	help
	  Crypto implementation to use for hash generation in Bootloader.

	config NSB_CRYPTO_OBERON_SHA256
		bool "Software SHA256"
		select NRF_OBERON
		select NSB_SHA256
		help
		  Software implementation of SHA256.

	config NSB_CRYPTO_CC310_SHA256
		bool "Hardware SHA256" if HAS_HW_NRF_CC310
		select NRF_CC310_BL
		select NRF_OBERON
		select NSB_SHA256
		help
		  Hardware implementation of SHA256.

endchoice

config NSB_PUBLIC_KEY_HASH_LEN
	int "Public key hash size (bytes)"
	default 16
	help
	  The length to which public key hashes in the list of Root of Trust
	  Public Keys are truncated.

endif # NSB_CRYPTO
```

## subsys/partition_manager/Kconfig
```kconfig
#
# Copyright (c) 2020 Nordic Semiconductor ASA
#
# SPDX-License-Identifier: LicenseRef-Nordic-5-Clause
#

menu "Partition Manager"

config PARTITION_MANAGER_ENABLED
	bool "Partition manager is enabled (read-only option)"
	help
	  Option which can be checked to see whether or not the
	  partition manager is enabled in the current build. Note that this
	  should ideally be a hidden option, but it can't due to limitations
	  in how parent images impose options on child images. Don't
	  change the value of this option.

# Override this option to use custom flash map implementation when partition
# manager is enabled.
config FLASH_MAP_CUSTOM
	bool
	default y
	depends on PARTITION_MANAGER_ENABLED

# These values are now set by partition manager, so hide the option.
config SRAM_SIZE
	int
	depends on !PARTITION_MANAGER_ENABLED

# These values are now set by partition manager, so hide the option.
config SRAM_BASE_ADDRESS
	hex
	depends on !PARTITION_MANAGER_ENABLED

menu "Zephyr subsystem configurations"

if FILE_SYSTEM_LITTLEFS
partition=LITTLEFS
partition-size=0x6000
rsource "Kconfig.template.partition_size"
endif


if SETTINGS
partition=SETTINGS_STORAGE
partition-size=0x2000
rsource "Kconfig.template.partition_size"
endif

if NVS && !SETTINGS_NVS
partition=NVS_STORAGE
partition-size=0x6000
rsource "Kconfig.template.partition_size"
endif

if ZIGBEE && !SOC_NRF52833
partition=ZBOSS_NVRAM
partition-size=0x8000
rsource "Kconfig.template.partition_size"
endif

if ZIGBEE && SOC_NRF52833
partition=ZBOSS_NVRAM
partition-size=0x4000
rsource "Kconfig.template.partition_size"
endif

if ZIGBEE
partition=ZBOSS_PRODUCT_CONFIG
partition-size=0x1000
rsource "Kconfig.template.partition_size"
endif

endmenu # Zephyr subsystem configurations


menu "Zephyr samples configurations"

if BT_RPMSG_NRF53 && SOC_NRF5340_CPUAPP
module=HCI_RPMSG
source "${ZEPHYR_BASE}/../nrf/subsys/partition_manager/Kconfig.template.build_strategy_domain"

DT_CHOSEN_Z_IPC_SHM := zephyr,ipc_shm

config RPMSG_NRF53_SRAM_SIZE
	# Hidden configuration to expose DT property as kconfig variable
	hex
	default "$(dt_chosen_reg_size_hex,$(DT_CHOSEN_Z_IPC_SHM))"

endif

endmenu # Zephyr samples configurations

menu "NCS subsystem configurations"

endmenu # NCS subsystem configurations

menu "NCS samples configurations"

if NRF_802154_SER_HOST && SOC_NRF5340_CPUAPP
module=802154_RPMSG
source "${ZEPHYR_BASE}/../nrf/subsys/partition_manager/Kconfig.template.build_strategy_domain"
endif

if BT_RPC && SOC_NRF5340_CPUAPP
module=RPC_HOST
source "${ZEPHYR_BASE}/../nrf/subsys/partition_manager/Kconfig.template.build_strategy_domain"

DT_CHOSEN_Z_IPC_SHM := zephyr,ipc_shm

config BT_RPC_HOST_NRF53_SRAM_SIZE
	# Hidden configuration to expose DT property as kconfig variable
	hex
	default "$(dt_chosen_reg_size_hex,$(DT_CHOSEN_Z_IPC_SHM))"

endif

endmenu # NCS samples configurations

config PM_SINGLE_IMAGE
	bool "Use the Partition Manager for single image builds" if !BUILD_WITH_TFM
	default y if BUILD_WITH_TFM
	select PARTITION_MANAGER_ENABLED
	help
	  Use the Partition Manager feature to partition the device even if
	  only a single image is included in the build. This is typically set
	  when a subsystem that defines its own Partition Manager configuration
	  is included in the build.

	  The option is always defined in builds where a TF-M image for the
	  Secure Execution environment is generated.

config PM_EXTERNAL_FLASH
	bool "Support external flash in Partition Manager"
	depends on PM_EXTERNAL_FLASH_DEV_NAME != ""
	depends on PM_EXTERNAL_FLASH_SIZE != 0
	depends on PM_EXTERNAL_FLASH_XSPI_MEM_MAPPED_ADDRESS != 0

config PM_EXTERNAL_FLASH_DEV_NAME
	string "Name of the external flash device"
	default "MX25R64" if BOARD_NRF5340DK_NRF5340_CPUAPP || BOARD_NRF5340DK_NRF5340_CPUAPP_NS
	default "MX25R64" if BOARD_THINGY53_NRF5340_CPUAPP || BOARD_THINGY53_NRF5340_CPUAPPNS
	default "MX25R64" if BOARD_NRF52840DK_NRF52840
	default ""
	help
	  Must match the 'drv_name' argument used when initializing the
	  driver for the external flash through the 'DEVICE...INIT'
	  function call. The value is used when calling 'device_get_binding'.

config PM_EXTERNAL_FLASH_SIZE
	hex "External flash size (in bytes)"
	default 0x200000 if BOARD_NRF5340DK_NRF5340_CPUAPP || BOARD_NRF5340DK_NRF5340_CPUAPP_NS
	default 0x200000 if BOARD_THINGY53_NRF5340_CPUAPP || BOARD_THINGY53_NRF5340_CPUAPPNS
	default 0x200000 if BOARD_NRF52840DK_NRF52840
	default 0

config PM_EXTERNAL_FLASH_BASE
	hex "External flash base address"
	default 0

config PM_EXTERNAL_FLASH_XSPI_MEM_MAPPED_ADDRESS
	hex "Address for the QSPI interface connected to the external flash"
	default 0x10000000 if BOARD_NRF5340DK_NRF5340_CPUAPP || BOARD_NRF5340DK_NRF5340_CPUAPP_NS
	default 0x10000000 if BOARD_THINGY53_NRF5340_CPUAPP || BOARD_THINGY53_NRF5340_CPUAPPNS
	default 0x12000000 if BOARD_NRF52840DK_NRF52840
	default 0  # This indicates that the value is not set
	help
	  See 'Memory Map' chapter in product specification. This value is only
	  used when generating hex files which can be flashed directly to the
	  secondary slot.

config PM_PARTITION_SIZE_MCUBOOT_SECONDARY
	hex "Size of MCUboot secondary partition"
	default 0
	depends on PM_EXTERNAL_FLASH
	help
	  Must be set to the same size as the 'MCUBOOT_PRIMARY' partition.

config PM_EXTERNAL_FLASH_MCUBOOT_SECONDARY
	bool "Locate secondary slot of MCUboot in external flash"
	depends on PM_EXTERNAL_FLASH
	depends on PM_PARTITION_SIZE_MCUBOOT_SECONDARY != 0
	help
	  Place the secondary partition of MCUboot in the external flash instead
	  of the internal flash.

config PM_IMAGE_NOT_BUILT_FROM_SOURCE
	bool
	help
	  Promptless helper config used to indicate that one or more
	  image is not built from source.

# Helper configs needed since 'SRAM_SIZE/BASE' use the chosen node.
config PM_SRAM_BASE
	hex
	default $(dt_node_reg_addr_hex,/soc/memory@21000000) if SOC_NRF5340_CPUNET
	default $(dt_node_reg_addr_hex,/soc/memory@20000000)

config PM_SRAM_SIZE
	hex
	default $(dt_node_reg_size_hex,/soc/memory@21000000) if SOC_NRF5340_CPUNET
	default $(dt_node_reg_size_hex,/soc/memory@20000000)

endmenu # Partition Manager
```

## subsys/pcd/Kconfig
```kconfig
#
# Copyright (c) 2020 Nordic Semiconductor ASA
#
# SPDX-License-Identifier: LicenseRef-Nordic-5-Clause
#

menu "Peripheral CPU DFU (PCD)"

menuconfig PCD
	bool "Peripheral CPU DFU Support (deprecated - use PCD_APP or PCD_NET)"
	select PCD_APP
	select PCD_NET

menuconfig PCD_APP
	bool "Peripheral CPU DFU Support for Application Processor"
	default y if SOC_SERIES_NRF53X && MCUBOOT && BT_RPMSG_NRF53

menuconfig PCD_NET
	bool "Peripheral CPU DFU Support for Network Processor"
	default y if SOC_NRF5340_CPUNET && IS_SECURE_BOOTLOADER
	select FLASH_PAGE_LAYOUT
	select STREAM_FLASH
	select STREAM_FLASH_ERASE

menuconfig PCD_USE_CONSTANTS
	bool "Use KConfig constants rather than pm_config.h"
	default n

if PCD_USE_CONSTANTS

menuconfig PCD_CMD_ADDRESS
	hex "PCD Command Address in RAM"
	default 0x2007e000

menuconfig NET_CORE_APP_OFFSET
	hex "Network Core Application Offset in Flash"
	default 0x8800

endif # PCD_USE_CONSTANTS

if PCD || PCD_APP || PCD_NET

module=PCD
module-dep=LOG
module-str=Peripheral Core DFU
source "$(ZEPHYR_BASE)/subsys/logging/Kconfig.template.log_config"

endif # PCD || PCD_NET || PCD_APP

if PCD_NET

config PCD_BUF_SIZE
	int
	default 512
	help
	  Must be <= the page size of the flash device.

endif # PCD_NET

endmenu
```

## sysbuild/Kconfig.ram_loader
```kconfig
#
# Copyright (c) 2024 Nordic Semiconductor
#
# SPDX-License-Identifier: LicenseRef-Nordic-5-Clause
#

menu "RAM Loader"

menuconfig NRF_RAM_LOADER
	bool "RAM Loader"
	help
	  Enable RAM Loader used to provision keys

if NRF_RAM_LOADER

config NRF_RAM_LOADER_TEST
	bool "Test configuration"
	help
	  For testing purposes

endif # NRF_RAM_LOADER

endmenu
```

## tests/subsys/dfu/dfu_target_stream/testcase.yaml
```yaml
tests:
  dfu.target_stream:
    platform_allow: native_posix native_posix_64 nrf52840dk_nrf52840
    tags: target_stream
```
