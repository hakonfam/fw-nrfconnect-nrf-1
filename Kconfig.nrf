## Kconfig.nrf
```kconfig
#
# Copyright (c) 2018 Nordic Semiconductor
#
# SPDX-License-Identifier: LicenseRef-BSD-5-Clause-Nordic
#

menu "Nordic nRF Connect"

rsource "subsys/Kconfig"
rsource "lib/Kconfig"
rsource "drivers/Kconfig"
rsource "ext/Kconfig"

orsource "../nrfxlib/Kconfig.nrfxlib"
orsource "../lwm2m/Kconfig"

endmenu
```

## drivers/fprotect/Kconfig
```kconfig
#
# Copyright (c) 2019 Nordic Semiconductor ASA
#
# SPDX-License-Identifier: LicenseRef-BSD-5-Clause-Nordic
#

config FPROTECT
	bool "Write-protect flash regions"
	depends on SOC_FAMILY_NRF
	help
	  Use hardware peripherals (BPROT, ACL, or SPU) to write-protect
	  regions of flash until next reset.

if FPROTECT
config FPROTECT_BLOCK_SIZE
    int "Block size of fprotect"
    default 32768 if SOC_NRF9160
    default $(dt_int_val,DT_SOC_NV_FLASH_0_ERASE_BLOCK_SIZE)
endif
```

## lib/ccm_mac/Kconfig
```kconfig
#
# Copyright (c) 2020 Nordic Semiconductor ASA
#
# SPDX-License-Identifier: LicenseRef-BSD-5-Clause-Nordic

config CCM_MAC
	bool "CCM based MAC calculation"
	depends on HAS_HW_NRF_CCM
	help
	  Enables library which performs MAC calculation using 0-key and 0-IV
	  for CCM algorithm using CCM peripheral.
```

## lib/mfu/Kconfig
```kconfig
#
# Copyright (c) 2019 Nordic Semiconductor ASA
#
# SPDX-License-Identifier: LicenseRef-BSD-5-Clause-Nordic
#

config MFU_ENABLE
	bool "Enable Modem Firmware Updater"
	select FLASH
	select DFU_TARGET_MODEM
	help
		The modem firmware updater is responsible for validating a modem update
		package and applying the update to the modem.

if MFU_ENABLE

config MFU_ALLOW_UNSIGNED
	bool "Allow unsigned modem updates"
	help
		Allow updates that does not include an ECDSA signature.

module=MFU
module-dep=LOG
module-str=Device Firmware Upgrade
source "${ZEPHYR_BASE}/subsys/logging/Kconfig.template.log_config"

config MFU_FLASH_BUF_SIZE
	int "Flash buffer size"
	default 512
	range 64 4096
	help
		Size of static buffer used for flash reading.

choice
	prompt "SHA256 backend"
	default MFU_SHA256_BACKEND_TINYCRYPT

config MFU_SHA256_BACKEND_MBEDTLS
	bool "Mbedtls"
	select NORDIC_SECURITY_BACKEND
	help
	  Use SHA256 implementation from mbedtls.

config MFU_SHA256_BACKEND_TINYCRYPT
	bool "Tinycrypt"
	select TINYCRYPT
	select TINYCRYPT_SHA256
	help
	  Use SHA256 implementation from Tinycrypt.

endchoice

choice
	prompt "Signature verification backend"
	default MFU_ECDSA_BACKEND_TINYCRYPT

config MFU_ECDSA_BACKEND_TINYCRYPT
	bool "Tinycrypt"
	select TINYCRYPT
	select TINYCRYPT_ECC_DSA
	help
	  Use ECDSA signature verification implementation from Tinycrypt.

endchoice

choice
	prompt "Non-volatile state storage backend"
	default MFU_STATE_SETTINGS

config MFU_STATE_SETTINGS
	bool "Settings"
	help
	  Use zephyr Settings for non-volatile storage.

config MFU_STATE_EXTFLASH
	bool "External flash"
	help
	  Use external flash device for non-volatile storage.
	  Two flash pages are required for safe read-modify-erase-write cycles.

endchoice

if MFU_STATE_EXTFLASH

config MFU_STATE_ADDR
	int "Flash address"
	default 0
	help
	  Address to use for state storage.

endif # MFU_STATE_SETTINGS

config MFU_STREAM_VERIFICATION_ENABLE
	bool "Enable verification of update stream"
	default y
	help
		Stream verification exposes functions to run verification on an
		update file as it is downloaded.
		This increases static RAM usage by ~150 bytes.

if MFU_STREAM_VERIFICATION_ENABLE

config MFU_STREAM_READ_OFFSET
	int "Read offset for incremental verification"
	default 8192
	help
		Stream verification calculates hash incrementally as a new image is
		downloaded. This offset can be used to make the read pointer
		"stay behind" the write pointer in case there are re-writes due to
		download interruptions.

endif # MFU_STREAM_VERIFICATION_ENABLE

endif # MFU_ENABLE
```

## modules/Kconfig.mcuboot
```kconfig
config SIGN_IMAGES
	bool "Sign images for MCUBoot"
	default y
	depends on MCUBOOT_BUILD_STRATEGY_FROM_SOURCE \
		   || BOOT_SIGNATURE_KEY_FILE != ""
	help
	  Sign images for MCUBoot as integrated part of the build stages using
	  the private key.

config BOOT_SIGNATURE_KEY_FILE
	string "MCUBoot PEM key file"
	depends on !MCUBOOT_BUILD_STRATEGY_FROM_SOURCE
	help
	  Absolute path to PEM key file containing the private key corresponding
	  to the public key included in MCUBoot. This will be used to sign the
	  image so that it can be verified by MCUBoot. Since MCUBoot is not
	  built from source, it is not possible for the build system to deduce
	  what key was used when compiling it. Hence, it is required that the
	  key is passed to the build system through this option.

config INIT_ARCH_HW_AT_BOOT
	default n if SPM
	default y
	help
	  The image will be booted directly by an unknown image which might not
	  leave the system in a clean state, so it is necessary to perform
	  architecture specific hardware initialization.

config BOOT_IMAGE_ACCESS_HOOKS_FILE
	string
	default "${ZEPHYR_NRF_MODULE_DIR}/modules/mcuboot/hooks/nrf53_hooks.c"
	depends on MCUBOOT && NRF53_MULTI_IMAGE_UPDATE

config BOOT_IMAGE_ACCESS_HOOKS
	bool
	default y if UPDATEABLE_IMAGE_NUMBER > 1 && NRF53_UPGRADE_NETWORK_CORE

# Workaround for not being able to have commas in macro arguments
DT_COMPAT_SIM_FLASH:= zephyr,sim-flash

config NRF53_MULTI_IMAGE_UPDATE
	bool "Support updating app core and net core in a single operation"
	default y
	depends on UPDATEABLE_IMAGE_NUMBER > 1
	depends on NRF53_UPGRADE_NETWORK_CORE
	depends on BOOT_IMAGE_ACCESS_HOOKS
	depends on FLASH_SIMULATOR
	depends on FLASH_SIMULATOR_DOUBLE_WRITES
	depends on !FLASH_SIMULATOR_STATS
	depends on PM_EXTERNAL_FLASH_MCUBOOT_SECONDARY
	depends on BOOT_UPGRADE_ONLY
	depends on $(dt_compat_enabled,$(DT_COMPAT_SIM_FLASH))

config NRF53_RAM_FLASH_SIZE
	hex
	depends on NRF53_MULTI_IMAGE_UPDATE
	default 0x40000
	help
	  256kB - The maximum size of a net core image.
	  When performing a multi image update on the nRF53 the net core app
	  image is buffered in RAM. This option is used to define the size of
	  the reserved RAM area. Note that this area is only used when the
	  MCUboot image is running, so no its value will affect the RAM
	  available for the running application.

config NORDIC_QSPI_NOR
	default y if PM_EXTERNAL_FLASH_MCUBOOT_SECONDARY

DT_ZEPHYR_FLASH := zephyr,flash
DT_CHOSEN_ZEPHYR_FLASH := $(dt_chosen_path,$(DT_ZEPHYR_FLASH))
config NORDIC_QSPI_NOR_FLASH_LAYOUT_PAGE_SIZE
	default $(dt_node_int_prop_int,$(DT_CHOSEN_ZEPHYR_FLASH),erase-block-size)
	help
	  Set the flash layout page size equal to the erase block size of the
	  chosen Zephyr flash devicetree node to ensure that swapping can be
	  performed.
```

## samples/crypto/persistent_key_usage/sample.yaml
```yaml
sample:
    description: This app provides an example of using peristent keys with the
        PSA APIs. A random AES persistent key is generated and imported
        to the PSA keystore.
    name: Persistent key example
tests:
    sample.aes_cbc:
        tags: introduction
        platform_allow: nrf5340dk_nrf5340_cpuappns nrf9160dk_nrf9160ns
        harness: console
        harness_config:
          type: multi_line
          regex:
            - "*Example finished successfully!*"
```

## samples/crypto/sha256/boards/nrf9160dk_nrf9160ns.conf
```kconfig
CONFIG_BUILD_WITH_TFM=y
CONFIG_TFM_PARTITION_AUDIT_LOG=n
CONFIG_MBEDTLS_RSA_C=n
CONFIG_TFM_BL2=n
CONFIG_PM_PARTITION_SIZE_BL2=0x0
```

## subsys/bluetooth/Kconfig
```kconfig
#
# Copyright (c) 2018 Nordic Semiconductor
#
# SPDX-License-Identifier: LicenseRef-BSD-5-Clause-Nordic
#

menu "Bluetooth Low Energy"

if BT

if BT_LL_NRFXLIB
rsource "controller/Kconfig"
endif # CONFIG_BT_LL_NRFXLIB

comment "BLE Libraries"
rsource "Kconfig.pool"
rsource "Kconfig.discovery"
rsource "Kconfig.scan"
rsource "Kconfig.link"
rsource "mesh/Kconfig"

rsource "services/Kconfig"

config HCI_RPMSG
	bool
	default y if (SOC_NRF5340_CPUAPP && BT)

if HCI_RPMSG
module=HCI_RPMSG
source "${ZEPHYR_BASE}/../nrf/subsys/partition_manager/Kconfig.template.build_strategy"
endif

endif # BT

endmenu
```

## subsys/bootloader/Kconfig.variant.template
```kconfig
#
# Copyright (c) 2022 Nordic Semiconductor
#
# SPDX-License-Identifier: LicenseRef-Nordic-5-Clause
#

comment "${ACI_PRELOAD_IMAGE} variant build"

config NCS_IS_VARIANT_IMAGE
	bool
	default y

# Load the regular Kconfig root of the base image.
source "${BASE_IMAGE_KCONFIG_ROOT}"
```

## subsys/dfu/fmfu_fdev/Kconfig
```kconfig
#
# Copyright (c) 2020 Nordic Semiconductor ASA
#
# SPDX-License-Identifier: LicenseRef-BSD-5-Clause-Nordic
#

menuconfig FMFU_FDEV
	bool "Full Modem Firmware Upgrade from flash device"
	depends on CDDL_GEN


if (FMFU_FDEV)

choice
	prompt "FMFU CDDL decoder build strategy"
	default FMFU_CDDL_DECODER_BUILD_STRATEGY_SOURCE
	help
	  The metadata contained in the FMFU binary is encoded using CDDL.
	  The decoder used for parsing this data is generated using cddl-gen.
	  The generated decoder is committed to the repository since the format
	  mostly will remain unchanged. The format is defined in the file
	  'modem_update.cddl'. New source files must be generated if this file
	  changes.

config FMFU_CDDL_DECODER_BUILD_STRATEGY_SOURCE
	bool "Use committed CDDL decoder source files"
	help
	  Select this option as long as 'modem_update.cddl' is unchanged.

config FMFU_CDDL_DECODER_BUILD_STRATEGY_GENERATE
	bool "Use cddl-gen python script to generate CDDL decoder source files"
	help
	  Select this option to re-generate the files needed to decode the
	  modem update CDDL. This is only needed if the format defined in
	  'modem_update.cddl' has been changed. Run the
	  'fmfu_cddl_modem_update_install' target to install the generated files
	  to the source directory.

endchoice

config MBEDTLS_HEAP_SIZE
	int
	default 4096

config FMFU_FDEV_SKIP_PREVALIDATION
	bool "Skip prevalidation of modem firmware"
	help
	  Set this option to skip prevalidation of the modem firmware. Note
	  that the modem will still verify the validity of the modem firmmware
	  before booting it, but only after it has been written to the modem.
	  This option

if FMFU_FDEV_SKIP_PREVALIDATION
	comment "FMFU_FDEV_SKIP_PREVALIDATE should ONLY be used during development"
endif

module=FMFU_FDEV
module-dep=LOG
module-str=FMFU FDEV
source "${ZEPHYR_BASE}/subsys/logging/Kconfig.template.log_config"

endif # FMFU_FDEV
```

## subsys/dfu/mfu_ext/Kconfig
```kconfig
#
# Copyright (c) 2020 Nordic Semiconductor ASA
#
# SPDX-License-Identifier: LicenseRef-BSD-5-Clause-Nordic
#

menuconfig MFU_EXT
	bool "Modem Firmware Upgrade from external flash"
	depends on CDDL_GEN


if (MFU_EXT)

config MBEDTLS_HEAP_SIZE
	int
	default 4096

module=MFU_EXT
module-dep=LOG
module-str=MFU EXT
source "${ZEPHYR_BASE}/subsys/logging/Kconfig.template.log_config"

endif #MFU_EXT
```

## subsys/dfu_data_writer/Kconfig
```kconfig
#
# Copyright (c) 2019 Nordic Semiconductor ASA
#
# SPDX-License-Identifier: LicenseRef-BSD-5-Clause-Nordic
#

menuconfig DFU_DATA_WRITER
	bool "DFU Data writer"
	select IMG_MANAGER
	select FLASH
	select FLASH_PAGE_LAYOUT
	select MPU_ALLOW_FLASH_WRITE

if (DFU_DATA_WRITER)

module=DFU_DATA_WRITER
module-dep=LOG
module-str=DFU Data writer
source "${ZEPHYR_BASE}/subsys/logging/Kconfig.template.log_config"

endif # DFU_DATA_WRITER
```

## subsys/key_loader/Kconfig
```kconfig
#
# Copyright (c) 2024 Nordic Semiconductor ASA
#
# SPDX-License-Identifier: LicenseRef-Nordic-5-Clause
#

menuconfig NRF_KEY_LOADER
	bool "Key loader"
	depends on NRF_SECURITY
	depends on PSA_WANT_ALG_PURE_EDDSA
	help
	  Enable support for loading keys built in at compile time.

if NRF_KEY_LOADER

config NRF_KEY_LOADER_BASE_PATH
	string "Path to directory that contains all key bin files"
	help
	  All required keys must be located in this directory with the correct name.
	  The required keys are:
	  - MANIFEST_PUBKEY_APPLICATION_GEN0-3
	  - MANIFEST_PUBKEY_RADIO_GEN0-3

endif # NRF_KEY_LOADER
```

## subsys/net/lib/http_fota_dl/Kconfig
```kconfig
#
# Copyright (c) 2019 Nordic Semiconductor ASA
#
# SPDX-License-Identifier: LicenseRef-BSD-5-Clause-Nordic
#

menuconfig HTTP_FOTA_DL
	bool "HTTP application update sample"
	select NRF_DOWNLOAD_CLIENT
	select IMG_MANAGER
	select FLASH
	select FLASH_PAGE_LAYOUT
	select MPU_ALLOW_FLASH_WRITE

if (HTTP_FOTA_DL)

module=HTTP_FOTA_DL
module-dep=LOG
module-str=HTTP Firmware Over the Air Download
source "${ZEPHYR_BASE}/subsys/logging/Kconfig.template.log_config"

endif # HTTP_FOTA_DL
```
