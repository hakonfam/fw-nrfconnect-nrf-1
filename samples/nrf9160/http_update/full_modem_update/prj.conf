## CMakeLists.txt
```
#
# Copyright (c) 2020 Nordic Semiconductor
#
# SPDX-License-Identifier: LicenseRef-BSD-5-Clause-Nordic
#

cmake_minimum_required(VERSION 3.13.1)

find_package(Zephyr REQUIRED HINTS $ENV{ZEPHYR_BASE})
project(full_modem_update)

target_sources(app PRIVATE src/main.c)
target_sources(app PRIVATE ../common/src/update.c)
target_include_directories(app PRIVATE ../common/include)
```

## Kconfig
```
#
# Copyright (c) 2020 Nordic Semiconductor ASA
#
# SPDX-License-Identifier: LicenseRef-BSD-5-Clause-Nordic
#

menu "HTTP full modem update sample"

config USE_HTTPS
	bool
	prompt "Use HTTPS for download"

config DOWNLOAD_HOST
	string "Modem firmware host name"
	help
	  Host part of URL to two modem firmwares. For example, the value of
	  this configuration should be 'http://foo.bar/' if the file is stored
	  in http://foo.bar/mfu_0.bin

config DOWNLOAD_MODEM_0_FILE
	string "Modem firmware 0 file name"
	help
	  File part of URL to the first of two modem firmwares. For example,
	  the value of this configuration should be 'mfu_0.bin' if the file
	  is stored in http://foo.bar/mfu_0.bin.

config DOWNLOAD_MODEM_0_VERSION
	string "Version string of modem firmware 0"
	help
	  This value is used to ensure that the sample does not download
	  the same modem firmware as what is already installed in the modem.
	  This is typically found in the file name of the ZIP which
	  contains the modem firmware, e.g. 'mfw_nrf9160_1.2.1'.

config DOWNLOAD_MODEM_1_FILE
	string "Modem firmware 1 file name"
	help
	  File part of URL to the second of two modem firmwares. For example,
	  the value of this configuration should be 'mfu_1.bin' if the file
	  is stored in http://foo.bar/mfu_1.bin.

endmenu

menu "Zephyr Kernel"
source "Kconfig.zephyr"
endmenu
```

## prj.conf
```kconfig
#
# Copyright (c) 2020 Nordic Semiconductor ASA
#
# SPDX-License-Identifier: LicenseRef-BSD-5-Clause-Nordic
#
# General config
CONFIG_NCS_SAMPLES_DEFAULTS=y
CONFIG_REBOOT=y

# Network
CONFIG_NETWORKING=y
CONFIG_NET_SOCKETS=y
CONFIG_NET_NATIVE=n

# LTE link control
CONFIG_LTE_LINK_CONTROL=y
CONFIG_LTE_AUTO_INIT_AND_CONNECT=n

# libmodem
CONFIG_NRF_MODEM_LIB=y
CONFIG_NRF_MODEM_LIB_SYS_INIT=n

# Library for buttons and LEDs
CONFIG_DK_LIBRARY=y
CONFIG_DK_LIBRARY_INVERT_LEDS=n

# Heap and stacks
CONFIG_HEAP_MEM_POOL_SIZE=2048
CONFIG_MAIN_STACK_SIZE=8192
CONFIG_SYSTEM_WORKQUEUE_STACK_SIZE=2048

# Stream flash
CONFIG_STREAM_FLASH=y
CONFIG_STREAM_FLASH_ERASE=y
CONFIG_FLASH=y

# GPIO
CONFIG_GPIO=y

# FOTA library
CONFIG_FOTA_DOWNLOAD=y

# Download client
CONFIG_DOWNLOAD_CLIENT=y
CONFIG_DOWNLOAD_CLIENT_STACK_SIZE=4096

# DFU Target
CONFIG_DFU_TARGET=y
CONFIG_DFU_TARGET_STREAM=y
CONFIG_DFU_TARGET_FULL_MODEM=y

# Full modem firmware from external flash support
CONFIG_FMFU_FDEV=y
CONFIG_CDDL_GEN=y

# Modem key management
CONFIG_MODEM_KEY_MGMT=y

# Crypto
CONFIG_OBERON_BACKEND=y
CONFIG_NORDIC_SECURITY_BACKEND=y
# Disable all non-used crypto
CONFIG_NRF_SECURITY_RNG=n
CONFIG_MBEDTLS_AES_C=n
CONFIG_MBEDTLS_CHACHA20_C=n
CONFIG_MBEDTLS_POLY1305_C=n
CONFIG_MBEDTLS_ECP_C=n
CONFIG_MBEDTLS_RSA_C=n
CONFIG_MBEDTLS_DHM_C=n
CONFIG_MBEDTLS_SHA1_C=n
CONFIG_MBEDTLS_SHA512_C=n
# This is the one we need
CONFIG_MBEDTLS_SHA256_C=y

CONFIG_DOWNLOAD_HOST="nrfconnectsdk.s3.eu-central-1.amazonaws.com"
CONFIG_DOWNLOAD_MODEM_0_FILE="fmfu_1.2.1.bin"
CONFIG_DOWNLOAD_MODEM_0_VERSION="mfw_nrf9160_1.2.1"

CONFIG_DOWNLOAD_MODEM_1_FILE="fmfu_1.2.2.bin"

# Prevalidation is not yet supported by the modem firmware, so skip it for now.
CONFIG_FMFU_FDEV_SKIP_PREVALIDATION=y

# It is necessary to increase the size of the buffers used by the modem lib
# in order to support full modem update.
CONFIG_NRF_MODEM_LIB_SHMEM_TX_SIZE=4096
CONFIG_NRF_MODEM_LIB_SHMEM_RX_SIZE=4096

CONFIG_NRF_MODEM_BUILD_FROM_SRC=y
CONFIG_DEBUG_OPTIMIZATIONS=y
```

## src/main.c
```c
/*
 * Copyright (c) 2021 Nordic Semiconductor ASA
 *
 * SPDX-License-Identifier: LicenseRef-Nordic-5-Clause
 */

#include <zephyr.h>
#include <modem/at_cmd.h>
#include <modem/nrf_modem_lib.h>
#include <dfu/dfu_target_full_modem.h>
#include <net/fota_download.h>
#include <nrf_modem_full_dfu.h>
#include <modem/modem_info.h>
#include <dfu/fmfu_fdev.h>
#include <drivers/gpio.h>
#include <stdio.h>
#include <string.h>
#include <update.h>

/* We assume that modem version strings (not UUID) will not be more than this */
#define MAX_MODEM_VERSION_LEN 256
#define EXT_FLASH_DEVICE DT_LABEL(DT_INST(0, jedec_spi_nor))
#define SW1_PIN (DT_GPIO_PIN(DT_ALIAS(sw1), gpios))
#define SW1_FLAGS (DT_GPIO_FLAGS(DT_ALIAS(sw1), gpios))

static struct k_work fmfu_work;
static const struct device *gpiob;
static struct gpio_callback gpio_cb;
static const struct device *flash_dev;
static char modem_version[MAX_MODEM_VERSION_LEN];

/* Buffer used as temporary storage when downloading the modem firmware, and
 * when loading the modem firmware from external flash to the modem.
 */
#define FMFU_BUF_SIZE (0x1000)
static uint8_t fmfu_buf[FMFU_BUF_SIZE];

static void fmfu_button_irq_disable(void)
{
	gpio_pin_interrupt_configure(gpiob, SW1_PIN, GPIO_INT_DISABLE);
}

static void fmfu_button_irq_enable(void)
{
	gpio_pin_interrupt_configure(gpiob, SW1_PIN, GPIO_INT_EDGE_TO_ACTIVE);
}

void fmfu_button_pressed(const struct device *gpiob, struct gpio_callback *cb,
			 uint32_t pins)
{
	k_work_submit(&fmfu_work);
	fmfu_button_irq_disable();
}

static void apply_fmfu_from_ext_flash(bool valid_init)
{
	int err;

	printk("Applying full modem firmware update from external flash\n");

	if (valid_init) {
		err = nrf_modem_lib_shutdown();
		if (err != 0) {
			printk("nrf_modem_lib_shutdown() failed: %d\n", err);
			return;
		}
	}

	err = nrf_modem_lib_init(FULL_DFU_MODE);
	if (err != 0) {
		printk("nrf_modem_lib_init(FULL_DFU_MODE) failed: %d\n", err);
		return;
	}

	err = fmfu_fdev_load(fmfu_buf, sizeof(fmfu_buf), flash_dev, 0);
	if (err != 0) {
		printk("fmfu_fdev_load failed: %d\n", err);
		return;
	}

	err = nrf_modem_lib_shutdown();
	if (err != 0) {
		printk("nrf_modem_lib_shutdown() failed: %d\n", err);
		return;
	}

	err = nrf_modem_lib_init(NORMAL_MODE);
	if (err != 0) {
		printk("nrf_modem_lib_init() failed: %d\n", err);
		return;
	}

	printk("Modem firmware update completed\n");
}

static void fmfu_work_cb(struct k_work *work)
{
	ARG_UNUSED(work);

	apply_fmfu_from_ext_flash(true);

	modem_info_string_get(MODEM_INFO_FW_VERSION, modem_version,
			      MODEM_INFO_MAX_RESPONSE_SIZE);
	printk("Current modem firmware version: %s\n", modem_version);
}

static int button_init(void)
{
	int err;

	gpiob = device_get_binding(DT_GPIO_LABEL(DT_ALIAS(sw1), gpios));
	if (gpiob == 0) {
		printk("Nordic nRF GPIO driver was not found!\n");
		return 1;
	}
	err = gpio_pin_configure(gpiob, SW1_PIN, GPIO_INPUT | SW1_FLAGS);
	if (err == 0) {
		gpio_init_callback(&gpio_cb, fmfu_button_pressed, BIT(SW1_PIN));
		err = gpio_add_callback(gpiob, &gpio_cb);
	}
	if (err == 0) {
		fmfu_button_irq_enable();
	}
	if (err != 0) {
		printk("Unable to configure SW1 GPIO pin!\n");
		return 1;
	}
	return 0;
}

static bool current_version_is_0(void)
{
	return strncmp(modem_version, CONFIG_DOWNLOAD_MODEM_0_VERSION,
		       strlen(CONFIG_DOWNLOAD_MODEM_0_VERSION)) == 0;
}

static const char *get_file(void)
{
	const char *file = CONFIG_DOWNLOAD_MODEM_0_FILE;

	if (current_version_is_0()) {
		file = CONFIG_DOWNLOAD_MODEM_1_FILE;
	}

	return file;
}

void fota_dl_handler(const struct fota_download_evt *evt)
{
	switch (evt->id) {
	case FOTA_DOWNLOAD_EVT_ERROR:
		printk("Received error from fota_download\n");
		/* Fallthrough */
	case FOTA_DOWNLOAD_EVT_FINISHED:
		apply_fmfu_from_ext_flash(true);
		break;

	default:
		break;
	}
}

void update_start(void)
{
	int err;

	/* Functions for getting the host and file */
	err = fota_download_start(CONFIG_DOWNLOAD_HOST, get_file(), SEC_TAG,
				  NULL, 0);
	if (err != 0) {
		update_sample_done();
		printk("fota_download_start() failed, err %d\n", err);
	}
}

static int num_leds(void)
{
	return current_version_is_0() ? 1 : 2;
}

void main(void)
{
	int err;

	printk("HTTP full modem update sample started\n");

	printk("%s\n", EXT_FLASH_DEVICE);
	flash_dev = device_get_binding(EXT_FLASH_DEVICE);
	if (flash_dev == NULL) {
		printk("Failed to get flash device: %s\n", EXT_FLASH_DEVICE);
		return;
	}

	err = nrf_modem_lib_init(NORMAL_MODE);
	if (err) {
		printk("Failed to initialize modem lib, err: %d\n", err);
		printk("This could indicate that an earlier update failed\n");
		printk("Trying to apply modem update from ext flash\n");
		apply_fmfu_from_ext_flash(false);
	}

	k_work_init(&fmfu_work, fmfu_work_cb);

	err = button_init();
	if (err != 0) {
		printk("button_init() failed: %d\n", err);
		return;
	}

	err = fota_download_init(fota_dl_handler);
	if (err != 0) {
		printk("fota_download_init() failed, err %d\n", err);
		return;
	}

	const struct dfu_target_full_modem_params params = {
		.buf = fmfu_buf,
		.len = sizeof(fmfu_buf),
		.dev = &(struct dfu_target_fmfu_fdev){ .dev = flash_dev,
						       .offset = 0,
						       .size = 0 }
	};

	err = dfu_target_full_modem_cfg(&params);
	if (err != 0) {
		printk("dfu_target_full_modem_cfg failed: %d\n", err);
		return;
	}

	err = at_cmd_init();
	if (err != 0) {
		printk("at_cmd_init failed: %d\n", err);
		return;
	}

	err = modem_info_init();
	if (err != 0) {
		printk("modem_info_init failed: %d\n", err);
		return;
	}

	modem_info_string_get(MODEM_INFO_FW_VERSION, modem_version,
			      MODEM_INFO_MAX_RESPONSE_SIZE);
	printk("Current modem firmware version: %s\n", modem_version);

	err = update_sample_init(&(struct update_sample_init_params){
					.update_start = update_start,
					.num_leds = num_leds()
				});
	if (err != 0) {
		printk("update_sample_init() failed, err %d\n", err);
		return;
	}

	printk("Press Button 1 to download and apply full modem firmware "
	       "update\n");
	printk("Press Button 2 to apply modem firmware update (no download)\n");
}
```
