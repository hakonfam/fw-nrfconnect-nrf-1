## CMakeLists.txt
```
#
# Copyright (c) 2019 Nordic Semiconductor
#
# SPDX-License-Identifier: LicenseRef-BSD-5-Clause-Nordic
#

cmake_minimum_required(VERSION 3.13.1)

find_package(Zephyr REQUIRED HINTS $ENV{ZEPHYR_BASE})
project(http_application_update)

target_sources(app PRIVATE src/main.c)
target_sources(app PRIVATE ../common/src/update.c)
target_include_directories(app PRIVATE ../common/include)
```

## Kconfig
```
#
# Copyright (c) 2019 Nordic Semiconductor ASA
#
# SPDX-License-Identifier: LicenseRef-BSD-5-Clause-Nordic
#

menu "HTTP application update sample"

config DOWNLOAD_HOST
	string "Application update host name"
	help
	  Host part of URL to application update binary. For example
	  if the file is stored in http://foo.bar/update.bin the value
	  of this configuration should be 'foo.bar'

config DOWNLOAD_FILE_V1
	string "Application update V1 file name"
	help
	  File part of URL to application update binary version 1. For example
	  if the file is stored in http://foo.bar/update.bin the value
	  of this configuration should be 'update.bin'

config DOWNLOAD_FILE_V2
	string "Application update V2 file name"
	help
	  File part of URL to application update binary version 2. For example
	  if the file is stored in http://foo.bar/update.bin the value
	  of this configuration should be 'update.bin'


config APPLICATION_VERSION
	int "Application version"
	default 1

config USE_HTTPS
	bool
	prompt "Use HTTPS for download"

endmenu

menu "Zephyr Kernel"
source "Kconfig.zephyr"
endmenu
```

## prj.conf
```kconfig
#
# Copyright (c) 2019 Nordic Semiconductor ASA
#
# SPDX-License-Identifier: LicenseRef-BSD-5-Clause-Nordic
#
# General config
CONFIG_NCS_SAMPLES_DEFAULTS=y
CONFIG_REBOOT=y

# Network
CONFIG_NETWORKING=y
CONFIG_NET_SOCKETS=y
CONFIG_NET_NATIVE=n

# LTE link control
CONFIG_LTE_LINK_CONTROL=y
CONFIG_LTE_AUTO_INIT_AND_CONNECT=n

# BSD library
CONFIG_BSD_LIBRARY=y
CONFIG_BSD_LIBRARY_SYS_INIT=n

# Library for buttons and LEDs
CONFIG_DK_LIBRARY=y
CONFIG_DK_LIBRARY_INVERT_LEDS=n

# Heap and stacks
CONFIG_HEAP_MEM_POOL_SIZE=2048
CONFIG_MAIN_STACK_SIZE=8192

# Image manager
CONFIG_IMG_MANAGER=y
CONFIG_FLASH=y
CONFIG_IMG_ERASE_PROGRESSIVELY=y

# GPIO
CONFIG_GPIO=y

# FOTA library
CONFIG_FOTA_DOWNLOAD=y

# Download client
CONFIG_DOWNLOAD_CLIENT=y
CONFIG_DOWNLOAD_CLIENT_STACK_SIZE=4096

# DFU Target
CONFIG_DFU_TARGET=y

# Modem key management
CONFIG_MODEM_KEY_MGMT=y

# Application Upgrade support
CONFIG_BOOTLOADER_MCUBOOT=y

# Sample configuration
CONFIG_DOWNLOAD_HOST="nrfconnectsdk.s3.eu-central-1.amazonaws.com"
CONFIG_DOWNLOAD_FILE_V1="app_update_v1.bin"
CONFIG_DOWNLOAD_FILE_V2="app_update_v2.bin"
CONFIG_APPLICATION_VERSION=1
```

## src/main.c
```c
/*
 * Copyright (c) 2019 Nordic Semiconductor ASA
 *
 * SPDX-License-Identifier: LicenseRef-BSD-5-Clause-Nordic
 */
#include <zephyr.h>
#include <dfu/mcuboot.h>
#include <modem/bsdlib.h>
#include <stdio.h>
#include "update.h"

static const char *get_host(void)
{
	return CONFIG_DOWNLOAD_HOST;
}

static const char *get_file(void)
{
#if CONFIG_APPLICATION_VERSION == 2
	return CONFIG_DOWNLOAD_FILE_V1;
#else
	return CONFIG_DOWNLOAD_FILE_V2;
#endif
}

static void finished(void)
{
	/* No handling needed */
}

static bool two_leds(void)
{
#if CONFIG_APPLICATION_VERSION == 2
	return true;
#else
	return false;
#endif
}

void main(void)
{
	int err;

	printk("HTTP application update sample started\n");

	err = bsdlib_init();
	if (err) {
		printk("Failed to initialize bsdlib!");
		return;
	}

	/* This is needed so that MCUBoot won't revert the update */
	boot_write_img_confirmed();

	err = update_sample_init(finished, get_host, get_file, two_leds);
	if (err != 0) {
		return;
	}

	printk("Press Button 1 for application firmware update\n");
}
```
