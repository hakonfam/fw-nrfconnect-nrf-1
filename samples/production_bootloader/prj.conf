## CMakeLists.txt
```
#
# Copyright (c) 2020 Nordic Semiconductor
#
# SPDX-License-Identifier: LicenseRef-BSD-5-Clause-Nordic
#

cmake_minimum_required(VERSION 3.13.1)

find_package(Zephyr HINTS $ENV{ZEPHYR_BASE})
project(production_bootloader)

target_include_directories(app PRIVATE include)

FILE(GLOB app_sources src/*.c)
target_sources(app PRIVATE ${app_sources})

zephyr_code_relocate(${CMAKE_CURRENT_SOURCE_DIR}/src/uart_transport.c SRAM)
zephyr_code_relocate(${CMAKE_CURRENT_SOURCE_DIR}/src/slip.c SRAM)
zephyr_code_relocate(${CMAKE_CURRENT_SOURCE_DIR}/src/recovery_bootloader.c SRAM)
zephyr_code_relocate(${ZEPHYR_BASE}/arch/arm/core/aarch32/isr_wrapper.S SRAM)

get_property(libs GLOBAL PROPERTY ZEPHYR_LIBS)
print(libs)

foreach(l ${libs} kernel)
  get_target_property(sources ${l} SOURCES)
  #message("${l} sources: ${sources}")
  foreach(f ${sources})
    set(prefix "")
    if (NOT IS_ABSOLUTE ${f})
      message("${l}: ${f} is not absolute")
      find_library(out NAMES ${l} HINTS ${ZEPHYR_BASE})
      print(out)
    endif()
    zephyr_code_relocate(${prefx}${f} SRAM)
  endforeach()
endforeach()

zephyr_linker_sources(SECTIONS custom-sections.ld)
```

## Kconfig
```
#
# Copyright (c) 2020 Nordic Semiconductor ASA
#
# SPDX-License-Identifier: LicenseRef-BSD-5-Clause-Nordic
#
#
menu "Zephyr Kernel"
source "Kconfig.zephyr"
endmenu

module = PRODUCTION_BOOTLOADER
module-str = p_bl
source "${ZEPHYR_BASE}/subsys/logging/Kconfig.template.log_config"

module = UART_TRANSPORT
module-str = uart
source "${ZEPHYR_BASE}/subsys/logging/Kconfig.template.log_config"
```

## prj.conf
```kconfig
#
# Copyright (c) 2020 Nordic Semiconductor ASA
#
# SPDX-License-Identifier: LicenseRef-BSD-5-Clause-Nordic
#

# TODO CONFIG_NCS_SAMPLES_DEFAULT=y

CONFIG_NRFX_NVMC=y
CONFIG_NRFX_UARTE0=y

CONFIG_LOG=y
CONFIG_UART_CONSOLE=n
CONFIG_RTT_CONSOLE=y
CONFIG_DEBUG_OPTIMIZATIONS=y
CONFIG_MPU_ALLOW_FLASH_WRITE=y
CONFIG_CODE_DATA_RELOCATION=y
```

## src/main.c
```c
/*
 * Copyright (c) 2020 Nordic Semiconductor ASA
 *
 * SPDX-License-Identifier: LicenseRef-BSD-5-Clause-Nordic
 */

#include "uart_transport.h"
#include "recovery_bootloader.h"

#include <kernel.h>
#include <zephyr.h>
#include <nrfx_uarte.h>

#define VECTOR_TABLE_SIZE 512
#define VECTOR_TABLE_ALIGNMENT 0x100

extern void arm_core_mpu_disable(void);
extern uint32_t __VECTOR_TABLE[VECTOR_TABLE_SIZE];

/* TODO ramfunc? */
__ramfunc static void wrap(void *param)
{
	ARG_UNUSED(param);

	nrfx_uarte_0_irq_handler();
	
}

uint32_t vector_table_RAM[VECTOR_TABLE_SIZE] __aligned(VECTOR_TABLE_ALIGNMENT);

int main(void)
{
	int err;
	arm_core_mpu_disable();

	IRQ_CONNECT(UARTE0_UART0_IRQn,
			4,
			wrap,
			NULL,
			0);

	for (int i = 0; i < VECTOR_TABLE_SIZE; i++) {
		vector_table_RAM[i] = *(uint8_t *)i;
	}

	// vector_table_RAM[UARTE0_UART0_IRQn + 16] = (uint32_t)wrap;

	__disable_irq();
	SCB->VTOR = (uint32_t)&vector_table_RAM;
	__DSB();
	__enable_irq();

	printk("HEllo schmello\n");
    // Move interrupt vector table to point at R-BL IRQs.
    // Initialize serial transport for DFU protocol.
    err = uart_transport_init();

    while (1) {
    }

    return 0;
}

/**
 * @}
 */
```

## include/recovery_bootloader.h
```c
/*
 * Copyright (c) 2020 Nordic Semiconductor ASA
 *
 * SPDX-License-Identifier: LicenseRef-BSD-5-Clause-Nordic
 */

/**@file
 *
 * @defgroup recovery_bl_protocol Recovery Bootloader(R-BL) protocol
 * @{
 * @ingroup  sdk_recovery_bl
 * @brief    Recovery bootloader commands processing.
 *
 */
 
#ifndef RECOVERY_BOOTLOADER_H__
#define RECOVERY_BOOTLOADER_H__

#include <stdbool.h>
#include <kernel.h>

#define RECOVERY_BL_PROTOCOL_VERSION 1                          /**< Recovery Bootloader protocol version. */

/* Common platform dependent defines. */
#define PAGE_SIZE                 (4096)                        /**< Flash page size. */
/* TODO Get this from DTS */
#define FLASH_SIZE                0x100000 /**< Flash size in bytes. */
#define BOOTLOADER_START_ADDRESS  (FLASH_SIZE - PAGE_SIZE)      /**< Address of the bootloader(last flash page). */
#define BOOTLOADER_SIZE           (PAGE_SIZE)                   /**< Size of the bootloader in bytes. */
#define MBR_START_ADDRESS         0                             /**< Address of the MBR(first flash page). */
#define MBR_SIZE                  (PAGE_SIZE)                   /**< Size of the MBR in bytes. */
#define UICR_SIZE                 (sizeof(NRF_UICR_Type))       /**< UICR registers size. */

/* Transport configuration defines. */
#define RECOVERY_BL_TRANSPORT_MTU 4200                          /**< Max packet size(before encoding to the SLIP). */

/**
 * @brief Recovery Bootloader commands numbers.
 */
typedef enum {
    RECOVERY_BL_CMD_RESPONSE,            /**< Response message ID. */
    RECOVERY_BL_CMD_DATA_WRITE,          /**< Write data to flash. */
    RECOVERY_BL_CMD_DATA_READ,           /**< Read data from flash. */
    RECOVERY_BL_CMD_PAGE_ERASE,          /**< Erase flash page. */
    RECOVERY_BL_CMD_CRC_CHECK,           /**< Compute CRC of given flash area. */
    RECOVERY_BL_CMD_RESET,               /**< Reset device. */
    RECOVERY_BL_CMD_UICR_WRITE,          /**< Write data to UICR registers. */
    RECOVERY_BL_CMD_UICR_ERASE,          /**< Erase UICR page. */
    RECOVERY_BL_CMD_UICR_READ,           /**< Read data from UICR. */
    RECOVERY_BL_CMD_VERSION_GET,         /**< Request protocol version. */
    RECOVERY_BL_CMD_DEVICE_INFO_GET,     /**< Request info about flash and UICR size. */
    RECOVERY_BL_CMD_ERASE_ALL,           /**< Erase all available flash and UICR. */
    RECOVERY_BL_CMD_COUNT,               /**< Number of available commands. */
} recovery_bl_cmd_t;

/**
 * @brief Recovery Bootloader response result codes.
 */
typedef enum {
    RECOVERY_BL_ACK,                     /**< Command executed properly. */
    RECOVERY_BL_NACK_INVALID_CRC,        /**< Received packet CRC is invalid. */
    RECOVERY_BL_NACK_INVALID_CMD,        /**< Requested command is not supported. */
    RECOVERY_BL_NACK_INVALID_MSG_SIZE,   /**< Request or response message is longer than MTU. */
    RECOVERY_BL_NACK_PAGE_PROTECTED,     /**< Reqested address is protected against erase and write. */
    RECOVERY_BL_NACK_ADDRESS_NOT_ERASED, /**< Write address is not erased. */
    RECOVERY_BL_NACK_DATA_NOT_ALIGNED,   /**< Write data and address are not word aligned. */
    RECOVERY_BL_NACK_INVALID_ADDRESS,    /**< Given address exceeds flash address space. */
    RECOVERY_BL_NACK_APPROTECT_ON,       /**< Operation is invalid when application is protected. */
    RECOVERY_BL_NACK_COUNT,              /**< Number of available result codes. */
} recovery_bl_response_result_t;

/**
 * @brief Request message header.
 */
typedef struct __packed {
    uint8_t sequence_no;                 /**< Packet sequence number. */
    uint8_t command;                     /**< Request command. */
} recovery_bl_msg_req_hdr_t;

/**
 * @brief Response message header.
 */
typedef struct __packed {
    uint8_t sequence_no;                 /**< Packet sequence number. */
    uint8_t command;                     /**< Response command. */
    uint8_t req_command;                 /**< Requested command. */
    uint8_t result;                      /**< Result of request execution. */
} recovery_bl_msg_resp_hdr_t;

/**
 * @brief @ref RECOVERY_BL_CMD_DATA_WRITE request command arguments.
 */
typedef struct __packed {
    uint32_t address;                    /**< Start address of write area. */
    uint32_t length;                     /**< Length of data to be written. */
    uint8_t  data[1];                    /**< Variable length table of data to be stored in flash. */
} recovery_bl_cmd_data_write_req_t;

/**
 * @brief @ref RECOVERY_BL_CMD_DATA_READ request command arguments.
 */
typedef struct __packed {
    uint32_t address;                    /**< Start address of read area. */
    uint32_t length;                     /**< Length of data to be read. */
} recovery_bl_cmd_data_read_req_t;

/**
 * @brief @ref RECOVERY_BL_CMD_DATA_READ response command arguments.
 */
typedef struct __packed {
    uint32_t address;                    /**< Start address of requested read area. */
    uint32_t length;                     /**< Length of requested data to be read. */
    uint8_t  data[1];                    /**< Variable length table storing requested data. */
} recovery_bl_cmd_data_read_resp_t;

/**
 * @brief @ref RECOVERY_BL_CMD_PAGE_ERASE request command arguments.
 */
typedef struct __packed {
    uint32_t address;                    /**< Address of the page to be erased. */
} recovery_bl_cmd_page_erase_req_t;

/**
 * @brief @ref RECOVERY_BL_CMD_CRC_CHECK request command arguments.
 */
typedef struct __packed {
    uint32_t address;                    /**< Start address of CRC compute area. */
    uint32_t length;                     /**< Length of CRC compute area. */
} recovery_bl_cmd_crc_check_req_t;

/**
 * @brief @ref RECOVERY_BL_CMD_CRC_CHECK response command arguments.
 */
typedef struct __packed {
    uint32_t crc;                        /**< Requested CRC value. */
} recovery_bl_cmd_crc_check_resp_t;

/**
 * @brief @ref RECOVERY_BL_CMD_UICR_WRITE request command arguments.
 */
typedef struct __packed {
    uint32_t address;                    /**< Start address of UICR write area. */
    uint32_t length;                     /**< Length of UICR write area. */
    uint8_t  data[1];                    /**< Variable length table of data to be stored in UICR registers. */
} recovery_bl_cmd_uicr_write_req_t;

/**
 * @brief @ref RECOVERY_BL_CMD_UICR_READ request command arguments.
 */
typedef struct __packed {
    uint32_t address;                    /**< Start address of UICR read area. */
    uint32_t length;                     /**< Length of UICR data to be read. */
} recovery_bl_cmd_uicr_read_req_t;

/**
 * @brief @ref RECOVERY_BL_CMD_UICR_READ response command arguments.
 */
typedef struct __packed {
    uint32_t address;                    /**< Start address of requested UICR read area. */
    uint32_t length;                     /**< Length of requested UICR data to be read. */
    uint8_t  data[1];                    /**< Variable length table storing requested UICR data. */
} recovery_bl_cmd_uicr_read_resp_t;

/**
 * @brief @ref RECOVERY_BL_CMD_VERSION_GET response command arguments.
 */
typedef struct __packed {
    uint32_t protocol_version;           /**< Requested protocol version number. */
    uint32_t fw_version;                 /**< Requested firmware version number. */
} recovery_bl_cmd_version_get_resp_t;

/**
 * @brief @ref RECOVERY_BL_CMD_DEVICE_INFO_GET response command arguments.
 */
typedef struct __packed {
    uint32_t ficr_part;                  /**< Device part code(FICR.INFO.PART). */
    uint32_t ficr_variant;               /**< Device part variant(FICR.INFO.VARIANT). */
    uint32_t flash_size;                 /**< Device flash size. */
    uint32_t page_size;                  /**< Device page size. */
    uint32_t uicr_size;                  /**< Device UICR suze. */
} recovery_bl_cmd_dev_info_get_resp_t;

/**
 * @brief Request message structure.
 */
typedef struct __packed {
    uint32_t                  msg_crc;                    /**< Packet CRC. */
    recovery_bl_msg_req_hdr_t hdr;                        /**< Request message header. */
    union {                                      /**< Union of request commands specific data. */
        recovery_bl_cmd_data_write_req_t write;           /**< Write request command data. */
        recovery_bl_cmd_data_read_req_t  read;            /**< Read request command data. */
        recovery_bl_cmd_page_erase_req_t erase;           /**< Page erase request command data. */
        recovery_bl_cmd_crc_check_req_t  crc_check;       /**< CRC check request command data. */
        recovery_bl_cmd_uicr_write_req_t uicr_write;      /**< UICR write request command data. */
        recovery_bl_cmd_uicr_read_req_t  uicr_read;       /**< UICR read request command data. */
    } __packed;
} recovery_bl_msg_req_t;

/**
 * @brief Response message structure.
 */
typedef struct __packed { /* TODO make all these __packed at the end as is done elsewhere */
    uint32_t                   msg_crc;                   /**< Packet CRC. */
    recovery_bl_msg_resp_hdr_t hdr;                       /**< Response messsage header. */
    union {                                      /**< Union of response commands specific data. */
        recovery_bl_cmd_data_read_resp_t    read;         /**< Read response command data. */
        recovery_bl_cmd_crc_check_resp_t    crc_check;    /**< CRC check response command data. */
        recovery_bl_cmd_uicr_read_resp_t    uicr_read;    /**< UICR read response command data. */
        recovery_bl_cmd_version_get_resp_t  version_get;  /**< Get version response command data. */
        recovery_bl_cmd_dev_info_get_resp_t dev_info_get; /**< Obtain info about device flash and UICR. */
    } __packed;
} recovery_bl_msg_resp_t;

/**
 * @brief   Callback to be called on response transmission end.
 *
 * @details It is used to reset device after sending response
 *          to the @ref RECOVERY_BL_CMD_RESET request.
 */
void recovery_bl_tx_end_callback(void);

/**
 * @brief   Function for R-BL protocol messages processing.
 *
 * @details Executes received request and forms response
 *          message.
 *
 * @param[in]  p_msg  Pointer to the received message.
 * @param[out] p_resp Pointer to the response message.
 * @param[in]  length Received packet length.
 *
 * @return  Length of the response message.
 */
uint32_t recovery_bl_msg_process(recovery_bl_msg_req_t  * p_msg,
                                 recovery_bl_msg_resp_t * p_resp,
                                 uint32_t                 length);

#endif // RECOVERY_BOOTLOADER_H__
```

## include/slip.h
```c
/*
 * Copyright (c) 2020 Nordic Semiconductor ASA
 *
 * SPDX-License-Identifier: LicenseRef-BSD-5-Clause-Nordic
 */

#ifndef SLIP_H__
#define SLIP_H__

#include <stdint.h>

#ifdef __cplusplus
extern "C" {
#endif

/** @file
 *
 * @defgroup slip SLIP encoding and decoding
 * @{
 * @ingroup app_common
 *
 * @brief  This module encodes and decodes SLIP packages.
 *
 * @details The SLIP protocol is described in @linkSLIP.
 */

/** @brief Status information that is used while receiving and decoding a packet. */
typedef enum
{
  SLIP_STATE_DECODING, //!< Ready to receive the next byte.
  SLIP_STATE_ESC_RECEIVED, //!< An ESC byte has been received and the next byte must be decoded differently.
  SLIP_STATE_CLEARING_INVALID_PACKET //!< The received data is invalid and transfer must be restarted.
} slip_read_state_t;

  /** @brief Representation of a SLIP packet. */
typedef struct
{
  slip_read_state_t   state; //!< Current state of the packet (see @ref slip_read_state_t).

  uint8_t             * p_buffer; //!< Decoded data.
  uint32_t            current_index; //!< Current length of the packet that has been received.
  uint32_t            buffer_len; //!< Size of the buffer that is available.
} slip_t;

/**@brief Function for encoding a SLIP packet.
 *
 * The maximum size of the output data is (2*input size + 1) bytes. Ensure that the provided buffer is large enough.
 *
 * @param[in,out]   p_output                The buffer where the encoded SLIP packet is stored. Ensure that it is large enough.
 * @param[in,out]   p_input                 The buffer to be encoded.
 * @param[in,out]   input_length            The length of the input buffer.
 * @param[out]      p_output_buffer_length  The length of the output buffer after the input has been encoded.
 *
 * @retval  NRF_SUCCESS         If the input was successfully encoded into output.
 * @retval  NRF_ERROR_NULL      If one of the provided parameters is NULL.
 */
int slip_encode(uint8_t * p_output,  uint8_t * p_input, uint32_t input_length, uint32_t * p_output_buffer_length);

/**@brief Function for decoding a SLIP packet.
 *
 * The decoded packet is put into @p p_slip::p_buffer. The index and buffer state is updated.
 *
 * Ensure that @p p_slip is properly initialized. The initial state must be set to @ref SLIP_STATE_DECODING.
 *
 * @param[in,out]   p_slip  State of the decoding process.
 * @param[in]       c       Byte to decode.
 *
 * @retval NRF_SUCCESS              If a packet has been parsed. The received packet can be retrieved from @p p_slip.
 * @retval NRF_ERROR_NULL           If @p p_slip is NULL.
 * @retval NRF_ERROR_NO_MEM         If there is no more room in the buffer provided by @p p_slip.
 * @retval NRF_ERROR_BUSY           If the packet has not been parsed completely yet.
 * @retval NRF_ERROR_INVALID_DATA   If the packet is encoded wrong. In this case, @p p_slip::state is set to @ref SLIP_STATE_CLEARING_INVALID_PACKET,
 *                                  and decoding will stay in this state until the END byte is received.
 */
int slip_decode_add_byte(slip_t * p_slip, uint8_t c);

#ifdef __cplusplus
}
#endif

#endif // SLIP_H__

/** @} */
```

## include/uart_transport.h
```c
/*
 * Copyright (c) 2020 Nordic Semiconductor ASA
 *
 * SPDX-License-Identifier: LicenseRef-BSD-5-Clause-Nordic
 */

/**@file
 *
 * @defgroup uart_transport Recovery bootloader UART transport layer
 * @{
 * @ingroup  sdk_recovery_bl
 * @brief    Recovery bootloader serial transport layer using UART.
 *
 * @details  The transport layer can be used for performing firmware updates
 *           over UART. The implementation uses SLIP to encode packets.
 */

#ifndef UART_TRANSPORT_H__
#define UART_TRANSPORT_H__

#include <stdint.h>

#ifdef __cplusplus
extern "C" {
#endif

/**
 * @brief  Function for initializing the transport layer.
 *
 * @retval NRF_SUCCESS              If the transport layer was successfully initialized.
 * @retval NRFX_ERROR_INVALID_STATE If UART driver is already initialized.
 * @retval NRFX_ERROR_BUSY          If other peripheral with the same ID is already in use.
 * @retval NRFX_ERROR_INTERNAL      If UART peripheral reported an error.
 */
int uart_transport_init(void);

#ifdef __cplusplus
}
#endif

#endif // UART_TRANSPORT_H__

/** @} */
```

## src/slip.c
```c
/*
 * Copyright (c) 2020 Nordic Semiconductor ASA
 *
 * SPDX-License-Identifier: LicenseRef-BSD-5-Clause-Nordic
 */

#include "slip.h"
#include <string.h>
#include <kernel.h>

#define SLIP_BYTE_END             0300    /* indicates end of packet */
#define SLIP_BYTE_ESC             0333    /* indicates byte stuffing */
#define SLIP_BYTE_ESC_END         0334    /* ESC ESC_END means END data byte */
#define SLIP_BYTE_ESC_ESC         0335    /* ESC ESC_ESC means ESC data byte */


int slip_encode(uint8_t * p_output,  uint8_t * p_input, uint32_t input_length, uint32_t * p_output_buffer_length)
{
    if (p_output == NULL || p_input == NULL || p_output_buffer_length == NULL)
    {
        return -EINVAL;
    }

    *p_output_buffer_length = 0;
    uint32_t input_index;

    for (input_index = 0; input_index < input_length; input_index++)
    {
        switch (p_input[input_index])
        {
            case SLIP_BYTE_END:
                p_output[(*p_output_buffer_length)++] = SLIP_BYTE_ESC;
                p_output[(*p_output_buffer_length)++] = SLIP_BYTE_ESC_END;
                break;

            case SLIP_BYTE_ESC:
                p_output[(*p_output_buffer_length)++] = SLIP_BYTE_ESC;
                p_output[(*p_output_buffer_length)++] = SLIP_BYTE_ESC_ESC;
                break;

            default:
                p_output[(*p_output_buffer_length)++] = p_input[input_index];
        }
    }
    p_output[(*p_output_buffer_length)++] = SLIP_BYTE_END;

    return 0;
}

int slip_decode_add_byte(slip_t * p_slip, uint8_t c)
{
    if (p_slip == NULL)
    {
        return -EINVAL;
    }

    if (p_slip->current_index == p_slip->buffer_len)
    {
        return -ENOMEM;
    }

    switch (p_slip->state)
    {
        case SLIP_STATE_DECODING:
            switch (c)
            {
                case SLIP_BYTE_END:
                    // finished reading packet
                    return 0;

                case SLIP_BYTE_ESC:
                    // wait for
                    p_slip->state = SLIP_STATE_ESC_RECEIVED;
                    break;

                default:
                    // add byte to buffer
                    p_slip->p_buffer[p_slip->current_index++] = c;
                    break;
            }
            break;

        case SLIP_STATE_ESC_RECEIVED:
            switch (c)
            {
                case SLIP_BYTE_ESC_END:
                    p_slip->p_buffer[p_slip->current_index++] = SLIP_BYTE_END;
                    p_slip->state = SLIP_STATE_DECODING;
                    break;

                case SLIP_BYTE_ESC_ESC:
                    p_slip->p_buffer[p_slip->current_index++] = SLIP_BYTE_ESC;
                    p_slip->state = SLIP_STATE_DECODING;
                    break;

                default:
                    // protocol violation
                    p_slip->state = SLIP_STATE_CLEARING_INVALID_PACKET;
                    return -EFAULT;
            }
            break;

        case SLIP_STATE_CLEARING_INVALID_PACKET:
            if (c == SLIP_BYTE_END)
            {
                p_slip->state = SLIP_STATE_DECODING;
                p_slip->current_index = 0;
            }
            break;
    }

    return -EAGAIN;
}
```

## src/uart_transport.c
```c
/*
 * Copyright (c) 2020 Nordic Semiconductor ASA
 *
 * SPDX-License-Identifier: LicenseRef-BSD-5-Clause-Nordic
 */

#include "uart_transport.h"

#include <string.h>
#include <slip.h>
#include <nrfx_uarte.h>
#include "recovery_bootloader.h"

#include <logging/log.h>

LOG_MODULE_REGISTER(uart_transport, CONFIG_UART_TRANSPORT_LOG_LEVEL);

/**< Size of maximum UART easy DMA transmission. */
/* TODO remove division */
#define MAX_UARTE_PACKET_LEN (((1 << UARTE0_EASYDMA_MAXCNT_SIZE) -1)/1024)

/**
 * @brief   UART transport layer instance.
 *
 * @details This structure contains status information
 *          and data buffer for the the transport layer.
 */
typedef struct {
    slip_t  slip;
    uint8_t uart_buffer;
    uint8_t recv_buffer[RECOVERY_BL_TRANSPORT_MTU + 1];
    uint8_t tx_buffer[RECOVERY_BL_TRANSPORT_MTU + 1];
} uart_transport_t;

static uart_transport_t transport;
static bool tx_flag;
static nrfx_uarte_t uart_instance = NRFX_UARTE_INSTANCE(0);
static uint32_t encoded_response_length;
static uint8_t *data_chunk_ptr;

 /**< Buffer for the response message encoded in the SLIP format. */
static uint8_t encoded_response[(2 * RECOVERY_BL_TRANSPORT_MTU) + 1];

/**
 * @brief   Function for transmitting R-BL response packet.
 *
 * @details Encodes message into SLIP format and sends
 *          through UART.
 *
 * @param[in] p_response Response message to be transmitted.
 * @param[in] length     Response message length.
 */
static void response_send(recovery_bl_msg_resp_t *p_response,
                          uint32_t length)
{
    /* Discard message if there is ongoing transmission. */
    if (!tx_flag)
    {
        /* Reserve TX buffer. */
        tx_flag = true;

        /* Encode message into SLIP buffer. */
        (void)slip_encode(encoded_response,
                          (uint8_t *)p_response,
                          length,
                          &encoded_response_length);

        /* Trigger UART transmission. */
        if (encoded_response_length < MAX_UARTE_PACKET_LEN)
        {
            (void)nrfx_uarte_tx(&uart_instance, encoded_response,
			        encoded_response_length);
            encoded_response_length = 0;
        }
        else
        {
            (void)nrfx_uarte_tx(&uart_instance, encoded_response,
				MAX_UARTE_PACKET_LEN);
            encoded_response_length -= MAX_UARTE_PACKET_LEN;
            data_chunk_ptr = &encoded_response[MAX_UARTE_PACKET_LEN];
        }
    }
}

/**
 * @brief   Callback function to be called on SLIP packet
 *          reception.
 *
 * @details Calls higher layer function for R-BL message
 *          processing and sends response.
 *
 * @param[in] p_dfu Pointer to the serial transport layer instance.
 */
static void on_packet_received(uart_transport_t *p_dfu)
{
    const uint32_t packet_payload_len = p_dfu->slip.current_index;

    if (packet_payload_len != 0)
    {
        /* Process received message. */
        uint32_t resp_len = recovery_bl_msg_process(
				(recovery_bl_msg_req_t *)p_dfu->recv_buffer,
				(recovery_bl_msg_resp_t *)p_dfu->tx_buffer,
				packet_payload_len);

        /* Send response if there is any. */
        if (resp_len != 0)
        {
            response_send((recovery_bl_msg_resp_t *)p_dfu->tx_buffer, resp_len);
        }
    }
}

/**
 * @brief   Callback function to be called on UART byte
 *          reception.
 *
 * @details Decodes received SLIP byte and calls received
 *          packet handler if decoded whole packet.
 *
 * @param[in] p_dfu  Pointer to the serial transport layer instance.
 * @param[in] p_data Pointer to the received bytes table.
 * @param[in] len    Received data length.
 */
static __INLINE void on_rx_complete(uart_transport_t *p_dfu, uint8_t *p_data)
{
    int err;


    /* Decode bytes received in SLIP format. */
    err = slip_decode_add_byte(&p_dfu->slip, p_data[0]);

    /* Check if received whole packet. */
    if (err == 0)
    {
        /* Process received message. */
        on_packet_received(p_dfu);

        /* Reset the SLIP decoding. */
        p_dfu->slip.current_index = 0;
        p_dfu->slip.state         = SLIP_STATE_DECODING;
    }

    /* Resume bytes reception. */
    (void)nrfx_uarte_rx(&uart_instance, &transport.uart_buffer, 1);
}

/**
 * @brief   Callback function to be called by UART driver.
 *
 * @details Reacts to the UART events.
 *
 * @param[in] p_event   Pointer to the UART event structure.
 * @param[in] p_context Pointer to the context.
 */
static void uart_event_handler(nrfx_uarte_event_t const *p_event,
			       void *p_context)
{
    switch (p_event->type)
    {
        case NRFX_UARTE_EVT_TX_DONE:
        {
            if (encoded_response_length != 0)
            {
                /* Trigger UART transmission. */
                if (encoded_response_length < MAX_UARTE_PACKET_LEN)
                {
                    (void)nrfx_uarte_tx(&uart_instance,
                                         data_chunk_ptr,
                                         encoded_response_length);
                    encoded_response_length = 0;
                }
                else
                {
                    (void)nrfx_uarte_tx(&uart_instance, data_chunk_ptr,
				        MAX_UARTE_PACKET_LEN);
                    encoded_response_length -= MAX_UARTE_PACKET_LEN;
                    data_chunk_ptr          += MAX_UARTE_PACKET_LEN;
                }
            }
            else
            {
                /* Release TX buffer. */
                tx_flag = false;
                /* Call higher layer transmission end callback. */
                recovery_bl_tx_end_callback();
            }
        } break;

        case NRFX_UARTE_EVT_RX_DONE:
        {
            /* Call RX data handler. */
            on_rx_complete((uart_transport_t *)p_context,
			   p_event->data.rxtx.p_data);
        } break;

        case NRFX_UARTE_EVT_ERROR:
        {
            /* Ignore error, continue receiving. */
            (void)nrfx_uarte_rx(&uart_instance, &transport.uart_buffer, 1);
        } break;
    }
}

int uart_transport_init(void)
{
    nrfx_err_t err = NRFX_SUCCESS;


    /* Initialize SLIP decoder. */
    transport.slip.p_buffer      = transport.recv_buffer;
    transport.slip.current_index = 0;
    transport.slip.buffer_len    = sizeof(transport.recv_buffer);
    transport.slip.state         = SLIP_STATE_DECODING;

    /* Set up UART port parameters. */
    /* TODO Use device tree for this  and below*/
    nrfx_uarte_config_t uart_config = NRFX_UARTE_DEFAULT_CONFIG(6, 8);

    uart_config.pselrts   = 5;
    uart_config.pseltxd   = 6;
    uart_config.pselcts   = 7;
    uart_config.pselrxd   = 8;

    uart_config.p_context = &transport;

    /* Start HFCLK clock - needed for high baudrate UART transfers. */
    NRF_CLOCK->TASKS_HFCLKSTART |= 1;

    /* Initialize UART. */
    err =  nrfx_uarte_init(&uart_instance, &uart_config, uart_event_handler);
    if (err != NRFX_SUCCESS) {
        LOG_ERR("Failed initializing uart");
        return err;
    }

    /* Start data reception. */
    err = nrfx_uarte_rx(&uart_instance, &transport.uart_buffer, 1);
    if (err != NRFX_SUCCESS)
    {
        LOG_ERR("Failed initializing rx");
    }

    LOG_DBG("UART initialized");

    return err;
}
```
