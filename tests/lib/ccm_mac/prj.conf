## CMakeLists.txt
```
cmake_minimum_required(VERSION 3.13.1)

include($ENV{ZEPHYR_BASE}/../nrf/cmake/boilerplate.cmake)
include($ENV{ZEPHYR_BASE}/cmake/app/boilerplate.cmake NO_POLICY_SCOPE)
project(ccm_mac)

FILE(GLOB app_sources src/*.c)
target_sources(app PRIVATE ${app_sources})
```

## prj.conf
```kconfig
CONFIG_ZTEST=y
CONFIG_CCM_MAC=y
```

## src/main.c
```c
#include <ztest.h>
#include <stdio.h>
#include <string.h>
#include <kernel.h>
#include <ccm_mac.h>

static void test_something(void)
{
	struct ccm_mac_ctx ctx;
	int rc = ccm_mac_init(&ctx);
	zassert_equal(rc, 0, NULL);
}

void test_main(void)
{
	ztest_test_suite(ccm_mac,
			ztest_unit_test(test_something)
			);

	ztest_run_test_suite(ccm_mac);
}
```
