## CMakeLists.txt
```
#
# Copyright (c) 2020 Nordic Semiconductor
#
# SPDX-License-Identifier: LicenseRef-BSD-5-Clause-Nordic
#

cmake_minimum_required(VERSION 3.13.1)

find_package(Zephyr REQUIRED HINTS $ENV{ZEPHYR_BASE})

# This check is needed since CMake does not fail when performing
# 'set_property' to a source file which does not exist.
set(pcd_dir ${ZEPHYR_BASE}/../nrf/subsys/pcd)
set(pcd_source ${pcd_dir}/src/pcd.c)
if (NOT EXISTS ${pcd_source})
  message(FATAL_ERROR "Unable to find source being tested")
endif()

# Set some defines in order to include code which is conditionally included.
set_source_files_properties(
  ${pcd_source}
  DIRECTORY ${pcd_dir}
  PROPERTIES COMPILE_DEFINITIONS
  "CONFIG_MCUBOOT")

zephyr_include_directories(.) # To get 'pm_config.h"

project(pcd_test)

FILE(GLOB app_sources src/*.c)

target_sources(app PRIVATE ${app_sources})
```

## prj.conf
```kconfig
#
# Copyright (c) 2020 Nordic Semiconductor ASA
#
# SPDX-License-Identifier: LicenseRef-BSD-5-Clause-Nordic
#
CONFIG_ZTEST=y
CONFIG_FLASH=y
CONFIG_TINYCRYPT=y

CONFIG_PCD=y
```

## prj_nrf52840_pca10056.conf
```kconfig
#
# Copyright (c) 2019 Nordic Semiconductor ASA
#
# SPDX-License-Identifier: LicenseRef-BSD-5-Clause-Nordic
#
CONFIG_ZTEST=y
CONFIG_FLASH=y
CONFIG_MPU_ALLOW_FLASH_WRITE=y

CONFIG_PCD=y
```

## src/main.c
```c
/*
 * Copyright (c) 2020 Nordic Semiconductor ASA
 *
 * SPDX-License-Identifier: LicenseRef-BSD-5-Clause-Nordic
 */

#include <ztest.h>
#include <string.h>
#include <stdbool.h>
#include <zephyr/types.h>
#include <devicetree.h>
#include <drivers/flash.h>
#include <dfu/pcd.h>

#define FLASH_NAME DT_CHOSEN_ZEPHYR_FLASH_CONTROLLER_LABEL

#define BUF_LEN ((32*1024) + 10) /* Some pages, and then some */

#define WRITE_OFFSET 0x80000

/* Only 'a' */
static const uint8_t data[BUF_LEN] = {[0 ... BUF_LEN - 1] = 'a'};
static uint8_t read_buf[sizeof(data)];
static uint8_t write_buf[100];
static off_t write_buf_offset = (off_t)write_buf;

#ifdef CONFIG_SOC_NRF5340_CPUAPP
static void test_pcd_network_core_update(void)
{
	int err = pcd_network_core_update(&data, sizeof(data));
	zassert_equal(err, 0, "Unexpected failure");

}
#else
static void test_pcd_network_core_update(void)
{
	ztest_test_skip();
}
#endif /* CONFIG_SOC_NRF5340_CPUAPP */

static void test_pcd_invalidate(void)
{
	pcd_fw_copy_invalidate();
	zassert_true(pcd_fw_copy_status_get() < 0, "Unexpected success");
}


static void test_pcd_fw_copy(void)
{
}

static void test_pcd_fw_copy_status_get(void)
{
}

void test_main(void)
{
	ztest_test_suite(pcd_test,
			 ztest_unit_test(test_pcd_network_core_update),
			 ztest_unit_test(test_pcd_invalidate),
			 ztest_unit_test(test_pcd_fw_copy),
			 ztest_unit_test(test_pcd_fw_copy_status_get)
			 );

	ztest_run_test_suite(pcd_test);
}
```
