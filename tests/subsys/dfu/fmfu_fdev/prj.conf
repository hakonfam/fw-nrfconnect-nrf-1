## CMakeLists.txt
```
#
# Copyright (c) 2020 Nordic Semiconductor
#
# SPDX-License-Identifier: LicenseRef-BSD-5-Clause-Nordic
#

cmake_minimum_required(VERSION 3.13.1)

find_package(Zephyr REQUIRED HINTS $ENV{ZEPHYR_BASE})
project(test_fmfu_fdev)

target_sources(app
  PRIVATE
  src/main.c
  )

target_include_directories(app
  PRIVATE
  ${NRF_DIR}/../nrfxlib/nrf_modem/include
  snetoesunthoeu
  )
```

## prj.conf
```kconfig
#
# Copyright (c) 2020 Nordic Semiconductor ASA
#
# SPDX-License-Identifier: LicenseRef-BSD-5-Clause-Nordic
#
#
CONFIG_ZTEST=y
CONFIG_FLASH=y
CONFIG_CDDL_GEN=y
CONFIG_NETWORKING=y
CONFIG_NET_SOCKETS=y
CONFIG_NET_NATIVE=n
CONFIG_NRF_MODEM_LIB=y
CONFIG_OBERON_BACKEND=y
CONFIG_NORDIC_SECURITY_BACKEND=y
CONFIG_HEAP_MEM_POOL_SIZE=2048
CONFIG_MAIN_STACK_SIZE=8192

CONFIG_FMFU_FDEV=y
```

## src/main.c
```c
/*
 * Copyright (c) 2020 Nordic Semiconductor ASA
 *
 * SPDX-License-Identifier: LicenseRef-BSD-5-Clause-Nordic
 */

#include <string.h>
#include <zephyr/types.h>
#include <stdbool.h>
#include <ztest.h>
#include <device.h>
#include <drivers/flash.h>
#include <dfu/fmfu_fdev.h>

#define FLASH_NAME DT_CHOSEN_ZEPHYR_FLASH_CONTROLLER_LABEL

static const struct device *fdev;
static uint8_t buf[128];

static void test_fmfu_fdev_load_null(void)
{
	int err;

	err = fmfu_fdev_load(NULL, sizeof(buf), fdev, 0);
	zassert_true(err < 0, "Expected negative error code for NULL argument");

	err = fmfu_fdev_load(buf, sizeof(buf), NULL, 0);
	zassert_true(err < 0, "Expected negative error code for NULL argument");
}

static void test_fmfu_fdev_load_invalid_offset(void)
{
	int err;

	err = fmfu_fdev_load(buf, sizeof(buf), fdev, 0x12345678);
	zassert_true(err < 0,
		     "Expected negative error code for invalid offset");

	err = fmfu_fdev_load(buf, sizeof(buf), fdev, 0x10000);
	zassert_true(err < 0,
		     "Expected negative error code for invalid offset");
}

void test_main(void)
{
	fdev = device_get_binding(FLASH_NAME);

	ztest_test_suite(lib_fmfu_fdev_test,
	     ztest_unit_test(test_fmfu_fdev_load_null),
	     ztest_unit_test(test_fmfu_fdev_load_invalid_offset)
	 );

	ztest_run_test_suite(lib_fmfu_fdev_test);
}
```
