## Kconfig
```
# Copyright (c) 2024 Nordic Semiconductor ASA
# SPDX-License-Identifier: LicenseRef-Nordic-5-Clause

config NRF_KEY_LOADER
	default y

config NRF_KEY_LOADER_BASE_PATH
	default "${ZEPHYR_NRF_MODULE_DIR}/applications/platform_key_loader/keys"

config SSF_ECHO_SERVICE_ENABLED
	default y

source "Kconfig.zephyr"
```

## prj.conf
```kconfig
# Build
CONFIG_SIZE_OPTIMIZATIONS=y

# The Zephyr CMSIS emulation assumes that ticks are ms, currently
CONFIG_SYS_CLOCK_TICKS_PER_SEC=1000

CONFIG_MAIN_STACK_SIZE=2048
CONFIG_HEAP_MEM_POOL_SIZE=2048

# Enable nordic security backend and PSA APIs
CONFIG_NRF_SECURITY=y
CONFIG_MBEDTLS_PSA_CRYPTO_C=y

CONFIG_CONSOLE=y
CONFIG_LOG=y

CONFIG_MBEDTLS_ENABLE_HEAP=y
CONFIG_MBEDTLS_HEAP_SIZE=8192

# Disable Oberon PSA crypto drivers
CONFIG_PSA_CRYPTO_DRIVER_OBERON=n

# Enable PSA crypto from SSF client
CONFIG_PSA_SSF_CRYPTO_CLIENT=y
CONFIG_SSF_PSA_CRYPTO_SERVICE_ENABLED=y

# Bugfixes
CONFIG_NRFS_MRAM_SERVICE_ENABLED=n
CONFIG_DCACHE=n
```

## src/main.c
```c
/*
 * Copyright (c) 2024 Nordic Semiconductor ASA
 * SPDX-License-Identifier: Apache-2.0
 */

int main(void)
{
	return 0;
}
```
